## meta-own/conf/bblayers.conf.sample
```bitbake
# POKY_BBLAYERS_CONF_VERSION is increased each time build/conf/bblayers.conf
# changes incompatibly
POKY_BBLAYERS_CONF_VERSION = "2"

BBPATH = "${TOPDIR}"
BBFILES ?= ""

BBLAYERS ?= " \
    HOME/poky/poky-dunfell/meta \
    HOME/poky/poky-dunfell/meta-poky \
    HOME/poky/meta-openembedded/meta-oe \
    HOME/poky/meta-openembedded/meta-multimedia \
    HOME/poky/meta-openembedded/meta-networking \
    HOME/poky/meta-openembedded/meta-perl \
    HOME/poky/meta-openembedded/meta-python \
    HOME/poky/meta-qt5 \
    HOME/poky/meta-raspberrypi \
    HOME/poky/meta-security \
    HOME/poky/meta-jumpnow \
    HOME/poky/meta-rpi \
    HOME/meta-own/ \
"
```

## meta-own/conf/layer.conf
```bitbake
# We have a conf and classes directory, append to BBPATH
BBPATH .= ":${LAYERDIR}"

# We have a recipes directory, add to BBFILES
BBFILES += "${LAYERDIR}/recipes*/*/*.bb ${LAYERDIR}/recipes*/*/*.bbappend ${LAYERDIR}/images/*.bb"

BBFILE_COLLECTIONS += "meta-own"
BBFILE_PATTERN_meta-own := "^${LAYERDIR}/"
BBFILE_PRIORITY_meta-own = "17"

LAYERSERIES_COMPAT_meta-own = "dunfell"
```

## meta-own/conf/local.conf.sample
```bitbake
# Local configuration for meta-own images
# Yocto Project 3.1 Poky distribution [dunfell] branch
# This is a sysvinit system

# mask wireguard from meta-openembedded/meta-networking
# use version in meta-jumpnow to support kernels < 5.6
# with wireguard-linux-compat
BBMASK = "meta-networking/recipes-kernel/wireguard"

LICENSE_FLAGS_WHITELIST = "commercial"

DISTRO_FEATURES = "ext2 opengl usbhost ${DISTRO_FEATURES_LIBC} ipv4"

PREFERRED_PROVIDER_jpeg = "libjpeg-turbo"
PREFERRED_PROVIDER_jpeg-native = "libjpeg-turbo-native"

PREFERRED_PROVIDER_udev = "eudev"
VIRTUAL-RUNTIME_init_manager = "sysvinit"
DISTRO_FEATURES_remove = "bluetooth"
DISTRO_FEATURES_remove = "3g"
DISTRO_FEATURES_remove = "wayland"
DISTRO_FEATURES_remove = "x11"
DISTRO_FEATURES_remove = "nfc"
DISTRO_FEATURES_remove = "nfs"
DISTRO_FEATURES_remove = "ext2"

DISTRO_FEATURES_BACKFILL_remove = "pulseaudio"

MACHINE_FEATURES_remove = "apm"
MACHINE_FEATURES_remove = "alsa"
MACHINE_FEATURES_remove = "wifi"
MACHINE_FEATURES_remove = "phone"
MACHINE_FEATURES_remove = "bluetooth"
MACHINE_FEATURES_remove = "qemu-usermode"
MACHINE_FEATURES_remove = "sdio"
MACHINE_FEATURES_remove = "screen"

IMAGE_FSTYPES = "tar.xz"

# Choose the board you are building for
#MACHINE = "raspberrypi"
#MACHINE = "raspberrypi0"
#MACHINE = "raspberrypi0-wifi"
#MACHINE = "raspberrypi2"
#MACHINE = "raspberrypi3"
#MACHINE = "raspberrypi4"
MACHINE ?= "raspberrypi-cm"
#MACHINE = "raspberrypi-cm3"
TCLIBC = "musl"

# Choices are Image or zImage if NOT using u-boot (no u-boot is the default)
# Choices are uImage or zImage if using u-boot, though if you choose zImage
# with u-boot you will also have to change the boot script boot command
KERNEL_IMAGETYPE = "zImage"

# uncomment for kernels < 5.6
WIREGUARD_COMPAT = "1"

DISABLE_VC4GRAPHICS = "1"
DISABLE_OVERSCAN = "1"
ENABLE_UART = "1"
ENABLE_RPI3_SERIAL_CONSOLE = "1"
SERIAL_CONSOLES = "115200;ttyAMA0"
# SERIAL_CONSOLES_forcevariable = ""

# default is still 4.19, uncomment the following for 5.4
# PREFERRED_VERSION_linux-raspberrypi = "5.4.%"

DISTRO = "poky"
PACKAGE_CLASSES = "package_ipk"

# i686 or x86_64
SDKMACHINE = "x86_64"

# for no root passwd uncomment the following and comment the two extra user lines
#EXTRA_IMAGE_FEATURES = "debug-tweaks"

# for a root passwd, change rootpass below to your password
INHERIT += "extrausers"
EXTRA_USERS_PARAMS = "usermod -P rootpass root; "

# this will force root to change password on first login
INHERIT += "chageusers"
CHAGE_USERS_PARAMS = "chage -d0 root; "

USER_CLASSES = "image-mklibs image-prelink"
PATCHRESOLVE = "noop"
RM_OLD_IMAGE = "1"
INHERIT += "rm_work"
CONF_VERSION = "1"
```
